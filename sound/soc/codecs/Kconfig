## sound/soc/codecs/Kconfig
```kconfig
config SND_SOC_ALL_CODECS
	tristate "Build all ASoC codec drivers"
	depends on SND_SOC && EXPERIMENTAL
	select I2C
	select SND_AC97_CODEC
	select SND_SOC_AC97_CODEC
	select SND_SOC_AD1939
	select SND_SOC_AD1980
	select SND_SOC_AK4535
	select SND_SOC_CS4270
	select SND_SOC_TLV320AICX
	select SND_SOC_UDA1380
	select SND_SOC_WM8510
	select SND_SOC_WM8580
	select SND_SOC_WM8711
	select SND_SOC_WM8750
	select SND_SOC_WM8753
	select SND_SOC_WM8772
	select SND_SOC_WM8900
	select SND_SOC_WM8950
	select SND_SOC_WM8951
	select SND_SOC_WM8956
	select SND_SOC_WM8971
	select SND_SOC_WM8974
	select SND_SOC_WM8976
	select SND_SOC_WM8980
	select SND_SOC_WM8990
	select SND_SOC_WM8991
	select SND_SOC_WM9712
	select SND_SOC_WM9713
	help
	  Normally ASoC codec drivers are only built if a machine driver which
          uses them is also built since they are only usable with a machine
          driver.  Selecting this option will allow these drivers to be built
	  anyway for test and development purposes.

          If unsure select "N".

config SND_SOC_AC97_CODEC
	tristate
	depends on SND_SOC

config SND_SOC_AD1939
	tristate
	depends on SND_SOC

config SND_SOC_AD1980
	tristate
	depends on SND_SOC

config SND_SOC_AK4535
	tristate
	depends on SND_SOC

config SND_SOC_TLV320
	tristate
	depends on SND_SOC

config SND_SOC_TLV320AIC3X
	tristate
	depends on SND_SOC && I2C

config SND_SOC_UDA1380
	tristate
	depends on SND_SOC

config SND_SOC_WM8510
	tristate
	depends on SND_SOC

config SND_SOC_WM8580
	tristate
	depends on SND_SOC

config SND_SOC_WM8711
	tristate
	depends on SND_SOC

config SND_SOC_WM8731
	tristate
	depends on SND_SOC && I2C

config SND_SOC_WM8750
	tristate
	depends on SND_SOC && I2C

config SND_SOC_WM8753
	tristate
	depends on SND_SOC && I2C

config SND_SOC_WM8772
	tristate
	depends on SND_SOC

config SND_SOC_WM8900
	tristate
	depends on SND_SOC

config SND_SOC_WM8950
	tristate
	depends on SND_SOC
	
config SND_SOC_WM8951
	tristate
	depends on SND_SOC

config SND_SOC_WM8956
	tristate
	depends on SND_SOC

config SND_SOC_WM8960
	tristate
	depends on SND_SOC

config SND_SOC_WM8971
	tristate
	depends on SND_SOC

config SND_SOC_WM8974
	tristate
	depends on SND_SOC

config SND_SOC_WM8976
	tristate
	depends on SND_SOC
	
config SND_SOC_WM8978
	tristate
	depends on SND_SOC

config SND_SOC_WM8980
	tristate
	depends on SND_SOC

config SND_SOC_WM8990
	tristate
	depends on SND_SOC

config SND_SOC_WM9712
	tristate
	depends on SND_SOC

config SND_SOC_WM9713
	tristate
	depends on SND_SOC

# Cirrus Logic CS4270 Codec
config SND_SOC_CS4270
	tristate
	depends on SND_SOC

# Cirrus Logic CS4270 Codec Hardware Mute Support
# Select if you have external muting circuitry attached to your CS4270.
config SND_SOC_CS4270_HWMUTE
	bool
	depends on SND_SOC_CS4270

config SND_SOC_WM8991
	tristate
	depends on SND_SOC

# Cirrus Logic CS4270 Codec VD = 3.3V Errata
# Select if you are affected by the errata where the part will not function
# if MCLK divide-by-1.5 is selected and VD is set to 3.3V.  The driver will
# not select any sample rates that require MCLK to be divided by 1.5.
config SND_SOC_CS4270_VD33_ERRATA
	bool
	depends on SND_SOC_CS4270

config SND_SOC_TLV320AIC3X
	tristate
	depends on SND_SOC && I2C
```
